## boards/arm/eyelash_sofle/board.yml
```yaml
boards:
  - name: eyelash_sofle_left
    vendor: eyelash
    socs:
      - name: nrf52840
  - name: eyelash_sofle_right
    vendor: eyelash
    socs:
      - name: nrf52840
```

## config/west.yml
```yaml
manifest:
  remotes:
    - name: zmkfirmware
      url-base: https://github.com/zmkfirmware
      # Additional modules containing boards/shields/custom code can be listed here as well.
      # See:
      # - https://zmk.dev/docs/features/modules
      # - https://docs.zephyrproject.org/3.5.0/develop/west/manifest.html#projects
  #  - name: gpeye
  #    url-base: https://github.com/GPeye
  projects:
   # - name: mario-peripheral-animation
   #   remote: gpeye
   #    revision: main
    - name: zmk
      remote: zmkfirmware
      revision: 8a44ef109ae301ce084b32dd5fe25200da9e402f # ZMK revision available during the verified April 3 build
      import: app/west.yml
  self:
    path: boards
```
